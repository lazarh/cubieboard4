## meta-cubieboard4/conf/layer.conf
```bitbake
BBPATH .= ":${LAYERDIR}"

BBFILES += "${LAYERDIR}/recipes*/*/*.bb ${LAYERDIR}/recipes*/*/*.bbappend"

BBFILE_COLLECTIONS += "cubieboard4"
BBFILE_PATTERN_cubieboard4 := "^${LAYERDIR}/"
BBFILE_PRIORITY_cubieboard4 = "11"

LAYERSERIES_COMPAT_cubieboard4 = "scarthgap"
LAYERDEPENDS_cubieboard4 = "sunxi"
```
